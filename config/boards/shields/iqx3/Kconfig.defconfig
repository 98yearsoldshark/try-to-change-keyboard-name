## config/boards/shields/iqx3/Kconfig.defconfig
```kconfig
# Copyright (c) 2020 The ZMK Contributors
# SPDX-License-Identifier: MIT

if SHIELD_iqx3

config ZMK_KEYBOARD_NAME
	default "Zshark.0.1"

endif
```
